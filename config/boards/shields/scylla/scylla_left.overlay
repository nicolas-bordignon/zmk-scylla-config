/*
 * Scylla Left Side - BastardKB Standard Pinout
 */

#include "scylla.dtsi"

&kscan0 {
    col-gpios
        = <&pro_micro 19 GPIO_ACTIVE_HIGH> // Col 0 (F4)
        , <&pro_micro 18 GPIO_ACTIVE_HIGH> // Col 1 (F5)
        , <&pro_micro 15 GPIO_ACTIVE_HIGH> // Col 2 (B1)
        , <&pro_micro 14 GPIO_ACTIVE_HIGH> // Col 3 (B3)
        , <&pro_micro 16 GPIO_ACTIVE_HIGH> // Col 4 (B2)
        , <&pro_micro 10 GPIO_ACTIVE_HIGH> // Col 5 (B6)
        ;
        
    row-gpios
        = <&pro_micro 4 (GPIO_ACTIVE_HIGH | GPIO_PULL_DOWN)>  // Row 0 (D4)
        , <&pro_micro 5 (GPIO_ACTIVE_HIGH | GPIO_PULL_DOWN)>  // Row 1 (C6)
        , <&pro_micro 6 (GPIO_ACTIVE_HIGH | GPIO_PULL_DOWN)>  // Row 2 (D7)
        , <&pro_micro 7 (GPIO_ACTIVE_HIGH | GPIO_PULL_DOWN)>  // Row 3 (E6)
        , <&pro_micro 8 (GPIO_ACTIVE_HIGH | GPIO_PULL_DOWN)>  // Row 4 (B4)
        ;
};
